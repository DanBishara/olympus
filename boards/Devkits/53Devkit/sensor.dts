#include <zephyr/dt-bindings/sensor/lsm6dso.h>

&i2c1 {
	status = "okay";

    pinctrl-0 = <&i2c1_default>;
    pinctrl-1 = <&i2c1_sleep>;
    pinctrl-names = "default", "sleep";

	accelerometer: lsm6dso@6a {
		compatible = "st,lsm6dso";
		reg = <0x6a>;                   // 0x6a if SDO=0, use 0x6b if SDO=1
		label = "LSM6DSOX";
		irq-gpios = <&gpio0 10 GPIO_ACTIVE_HIGH>;
		int-pin = <1>;          // 1 = INT1, 2 = INT2
        accel-pm = <LSM6DSO_DT_XL_ULP_MODE>;
        accel-range = <LSM6DSO_DT_FS_2G>;
        accel-odr = <LSM6DSO_DT_ODR_12Hz5>;
        gyro-pm = <LSM6DSO_DT_GY_NORMAL_MODE>;
	};
};
