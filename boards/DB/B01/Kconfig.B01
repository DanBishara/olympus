## boards/DB/B01/Kconfig.B01
```kconfig
config BOARD_B01
	select SOC_NRF5340_CPUAPP_QKAA if BOARD_B01_NRF5340_CPUAPP
	select SOC_NRF5340_CPUAPP_QKAA if BOARD_B01_NRF5340_CPUAPP_NS
	select SOC_NRF5340_CPUNET_QKAA if BOARD_B01_NRF5340_CPUNET
```

## boards/DB/B01/board.yml
```yaml
board:
  name: B01
  vendor: DB
  socs:
  - name: nrf5340
    variants:
    - name: ns
      cpucluster: cpuapp
```

## boards/DB/B02/Kconfig.B02
```kconfig
config BOARD_B02
	select SOC_NRF54L15_CPUAPP if BOARD_B02_NRF54L15_CPUAPP
	select SOC_NRF54L15_CPUFLPR if \
		BOARD_B02_NRF54L15_CPUFLPR || \
		BOARD_B02_NRF54L15_CPUFLPR_XIP
```

## boards/DB/B02/Kconfig.defconfig
```kconfig
if BOARD_B02_CPUAPP

config ROM_START_OFFSET
	default 0x800 if BOOTLOADER_MCUBOOT

endif # BOARD_B02_CPUAPP
```

## boards/DB/B02/board.yml
```yaml
board:
  name: B02
  vendor: DB
  socs:
  - name: nrf54l15
    variants:
    - name: xip
      cpucluster: cpuflpr
```

## boards/forge/rev1/Kconfig.rev1
```kconfig
config BOARD_REV1
	select SOC_NRF54L15_CPUAPP if BOARD_REV1_NRF54L15_CPUAPP
	select SOC_NRF54L15_CPUFLPR if \
		BOARD_REV1_NRF54L15_CPUFLPR || \
		BOARD_REV1_NRF54L15_CPUFLPR_XIP
```

## boards/forge/rev1/board.yml
```yaml
board:
  name: rev1
  vendor: forge
  socs:
  - name: nrf54l15
    variants:
    - name: xip
      cpucluster: cpuflpr
```
