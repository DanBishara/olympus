/dts-v1/;
#include <nordic/nrf5340_cpuappns_qkaa.dtsi>
#include "B01-pinctrl.dtsi"

/ {
	model = "first iteration of the fitness tracker pcb (CPUAPP Non-Secure)";
	compatible = "DB,B01-cpuapp-ns";

	chosen {
		zephyr,sram = &sram0_ns;
		zephyr,flash = &flash0;
		zephyr,code-partition = &slot0_ns_partition;
	};
};

#include "B01-cpuapp_partitioning.dtsi"
#include "B01-shared_sram.dtsi"
